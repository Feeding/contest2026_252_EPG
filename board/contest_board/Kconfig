## board/contest_board/apps/eyes/Kconfig
```kconfig
config CONTEST_EYES
	bool "Contest board robot eyes animation"
	default n
	depends on VIDEO_FB
	---help---
		Procedural robot-eye animation ("eyes" NSH command) for the two
		GC9D01 panels: gaze wander, blinking, dirty-rectangle updates.

config CONTEST_EYES_STACKSIZE
	int "eyes stack size"
	default 4096
	depends on CONTEST_EYES
```

## board/contest_board/apps/face/Kconfig
```kconfig
config CONTEST_FACE
	bool "Contest board robot face demo"
	default n
	depends on VIDEO_FB && INPUT_BUTTONS
	---help---
		"face" NSH command: procedural eyes idle plus the vendor's
		MJPEG expression clips from the SD card, S2 to play, S3 to
		quit.
```

## board/contest_board/apps/snap/Kconfig
```kconfig
config CONTEST_SNAP
	bool "Contest board camera snapshot command"
	default n
	depends on I2C_BITBANG
	---help---
		"snap [path]" NSH command: capture one JPEG frame from the
		GC2145 DVP camera and write it to a file.
```

## board/contest_board/chip/Kconfig
```kconfig
#
# For a description of the syntax of this configuration file,
# see the file kconfig-language.txt in the NuttX tools repository.
#
# BK7258 (Beken) chip layer for openvela / NuttX.
#

if ARCH_CHIP_CUSTOM

comment "BK7258 Configuration Options"

choice
	prompt "Beken Chip Selection"
	default ARCH_CHIP_BK7258

config ARCH_CHIP_BK7258
	bool "bk7258"
	select ARCH_ARMV8M
	select ARCH_CORTEXM33
	select ARCH_HAVE_FPU
	select ARCH_HAVE_MPU
	select ARCH_HAVE_FETCHADD
	select ARCH_HAVE_IRQPRIO
	select ARM_HAVE_MPU_UNIFIED
	select ARMV8M_HAVE_STACKCHECK
	select ARMV8M_USEBASEPRI
	---help---
		Beken BK7258: Armv8-M STAR-MC1 (Cortex-M33 compatible) MCU up to
		480MHz, with Wi-Fi 6 and Bluetooth LE 5.4, 640KB shared SRAM,
		XIP flash and SiP PSRAM.

endchoice

menu "BK7258 Peripheral Support"

config BK7258_UART0
	bool "UART0"
	default y
	select UART0_SERIALDRIVER
	select ARCH_HAVE_SERIAL_TERMIOS
	---help---
		UART0 is routed to GPIO10 (RX) / GPIO11 (TX), which is the same
		pin pair used by the ROM flash-download engine (DL_UART).  On the
		Agora ConvoAI Kit R1 these pins are wired to the on-board CH340
		USB-serial bridge, so UART0 is the natural console.

config BK7258_UART1
	bool "UART1"
	default n
	select UART1_SERIALDRIVER
	select ARCH_HAVE_SERIAL_TERMIOS
	---help---
		UART1 on GPIO0 (TX) / GPIO1 (RX).

config BK7258_UART2
	bool "UART2"
	default n
	select UART2_SERIALDRIVER
	select ARCH_HAVE_SERIAL_TERMIOS
	---help---
		UART2 on GPIO40 (RX) / GPIO41 (TX), alternate GPIO30/GPIO31.

endmenu # BK7258 Peripheral Support

config BK7258_EARLY_MARKERS
	bool "Emit early bring-up markers on UART0"
	default n
	---help---
		Push single characters straight into the UART0 TX FIFO at each step
		of __start(), before this port configures the clocks, the pins or
		the serial driver.

		These only work once bk7258_lowsetup() has configured the console.
		The Beken bootloader does not leave UART0 running: it deinitialises
		the UART and touches the system clock registers immediately before
		branching to the application, so markers placed ahead of the port's
		own UART setup write into a peripheral that has been torn down.

		Markers: 1=entry, 2=VTOR set, 3=FPU on, 4=.data/.bss ready,
		5=clocks up, 6=console configured.

config BK7258_LED_PROBE
	bool "Blink the board LEDs at __start()"
	default n
	---help---
		Alternate the two board LEDs (red on GPIO40, green on GPIO41 per the
		schematic) forever, as the first thing __start() does.

		This answers "did the bootloader hand control to this image?" using
		only the always-on GPIO block: no clock gating, no pin mux, no UART,
		and no assumption about whether SYSRESETREQ reboots this SoC.  If the
		LEDs alternate, the image is running.

		The board will not boot anything while this is enabled.

config BK7258_TXPIN_PROBE
	bool "Bit-bang GPIO11 (UART0 TX) at __start()"
	default n
	---help---
	  Toggle GPIO11 as a plain GPIO, roughly a millisecond per level, as the
	  first thing __start() does.

	  GPIO11 is UART0 TX and reaches the CH340 bridge, confirmed by both the
	  datasheet and the board schematic.  Every level change lands in the
	  host's receiver as a framing error, so the host sees a steady stream of
	  bytes: reading anything at all from the port proves this image executes.

	  Unlike the LED probe this needs no clock gate, no pin mux, no UART
	  peripheral, no power rail, and nothing for a person to watch -- the
	  answer comes back over the same cable used for flashing.

	  The board will not boot anything while this is enabled.

config BK7258_TXPIN_TRACE
	bool "Bit-bang a GPIO11 burst at each step of __start()"
	default n
	---help---
	  Emit one burst on GPIO11 at each step of the boot -- entry, vector table
	  and FPU, .bss/.data, clocks, console, board init -- with the line held
	  idle in between so the host sees them as separate runs of bytes.

	  Counting the bursts locates the step that hangs without needing a
	  working console, a debugger, or one flash cycle per checkpoint.  Six
	  bursts means __start() ran to completion and nx_start() was entered.

	  Unlike the other probes this one does not stop the boot: it only slows
	  it down, about half a second per step.

config BK7258_UART_DUMP
	bool "Shift the console UART's registers out on GPIO11"
	default n
	---help---
	  After bk7258_lowsetup() returns, read the console UART's line
	  configuration, FIFO status and device id back and shift each out on
	  GPIO11 as a 32-bit pattern -- long burst for a one, short for a zero --
	  repeating forever.

	  Use this when the console produces nothing and there is no way to ask it
	  why: arm_lowputc() waits on write-ready with no timeout, so a UART that
	  never asserts it stops the boot silently.  A device id of zero says the
	  block has no clock; a plausible id with write-ready clear says it is
	  clocked but misconfigured.

	  The board will not boot anything while this is enabled.

config BK7258_TXPIN_PROBE_LATE
	bool "Bit-bang GPIO11 just before nx_start()"
	default n
	---help---
	  The same GPIO11 bit-bang as BK7258_TXPIN_PROBE, but placed after the
	  clocks, the console and board_early_initialize() rather than before
	  them, so the two together bisect the boot.

	  Traffic on the port means everything this chip layer does completed and
	  a fault would be inside NuttX; silence means the boot dies somewhere in
	  bk7258_start.c above the call.

	  The board will not boot anything while this is enabled.

config BK7258_SELFRESET_PROBE
	bool "Self-reset probe at __start()"
	default n
	---help---
		Spin for about half a second at the very top of __start() and then
		trigger a system reset, forever.

		This answers "did the bootloader hand control to this image?"
		without relying on the console, which is useful precisely when the
		console is the thing that is not working.  If this code runs, the
		board cycles through the bootloader roughly twice a second, so its
		UART download window keeps reopening and tools/bk_flash.py links up
		with no manual RST press at all.  If a manual reset is still
		needed, the image never got control.

		The reset is done by arming the watchdog, not by writing ARMv8-M's
		SYSRESETREQ: the vendor SDK never touches AIRCR anywhere, and both
		its bk_reboot() and the Beken bootloader reboot through the
		watchdog, so SYSRESETREQ does not appear to reset this SoC.  No pin
		is driven, so this cannot contend with anything else on the board.

		The board will not boot anything while this is enabled.  Turn it
		off once the question is answered.

endif # ARCH_CHIP_CUSTOM
```

## board/contest_board/configs/nsh/defconfig
```kconfig
#
# NSH baseline for the Agora ConvoAI Kit R1 (Beken BK7258), CPU0.
#
# Console is UART0 on GPIO10/GPIO11, which reaches the host through the
# on-board CH340 USB-serial bridge.
#
CONFIG_ARCH="arm"
CONFIG_ARCH_BOARD_CUSTOM=y
CONFIG_ARCH_BOARD_CUSTOM_DIR="../vendor/openvela/boards/contest2026_252_board"
CONFIG_ARCH_BOARD_CUSTOM_DIR_RELPATH=y
CONFIG_ARCH_BOARD_CUSTOM_NAME="nsh"
CONFIG_ARCH_CHIP_ARM_CUSTOM=y
CONFIG_ARCH_CHIP_BK7258=y
CONFIG_ARCH_CHIP_CUSTOM=y
CONFIG_ARCH_CHIP_CUSTOM_DIR="../vendor/openvela/boards/contest2026_252_board/chip"
CONFIG_ARCH_CHIP_CUSTOM_DIR_RELPATH=y
CONFIG_ARCH_CHIP_CUSTOM_NAME="bk7258"
CONFIG_ARCH_IDLE_CUSTOM=y
CONFIG_ARCH_INTERRUPTSTACK=8192
CONFIG_ARCH_STACKDUMP=y
CONFIG_ARMV8M_SYSTICK=y
CONFIG_BK7258_EARLY_MARKERS=y
# CONFIG_BK7258_LED_PROBE is not set
# CONFIG_BK7258_TXPIN_PROBE is not set
# CONFIG_BK7258_TXPIN_PROBE_LATE is not set
# CONFIG_BK7258_TXPIN_TRACE is not set
# CONFIG_BK7258_UART_DUMP is not set
CONFIG_BK7258_UART0=y
CONFIG_BOARDCTL=y
CONFIG_BOARDCTL_RESET=y
CONFIG_BOARD_EARLY_INITIALIZE=y
CONFIG_BOARD_LATE_INITIALIZE=y
CONFIG_BOARD_LOOPSPERMSEC=12000
CONFIG_BUILTIN=y
CONFIG_DEBUG_ASSERTIONS=y
CONFIG_DEBUG_ERROR=y
CONFIG_DEBUG_FEATURES=y
CONFIG_DEBUG_SYMBOLS=y
CONFIG_DEBUG_WARN=y
CONFIG_DEFAULT_TASK_STACKSIZE=4096
CONFIG_DEV_CONSOLE=y
CONFIG_DEV_NULL=y
CONFIG_DEV_ZERO=y
CONFIG_FS_PROCFS=y
CONFIG_IDLETHREAD_STACKSIZE=74648
CONFIG_INIT_ENTRYPOINT="nsh_main"
CONFIG_INIT_STACKSIZE=4096
CONFIG_LIBC_PERROR_STDOUT=y
CONFIG_LIBC_STRERROR=y
CONFIG_MAX_TASKS=16
CONFIG_NSH_ARCHINIT=y
CONFIG_NSH_BUILTIN_APPS=y
CONFIG_NSH_FILEIOSIZE=512
CONFIG_NSH_LINELEN=64
CONFIG_NSH_READLINE=y
CONFIG_PREALLOC_TIMERS=4
CONFIG_RAM_SIZE=655360
CONFIG_RAM_START=0x28000000
CONFIG_RAW_BINARY=y
CONFIG_RR_INTERVAL=200
CONFIG_SCHED_WAITPID=y
CONFIG_STACK_COLORATION=y
CONFIG_START_DAY=1
CONFIG_START_MONTH=1
CONFIG_START_YEAR=2026
CONFIG_SYSTEM_NSH=y
CONFIG_TASK_NAME_SIZE=16
CONFIG_UART0_BAUD=115200
CONFIG_UART0_RXBUFSIZE=256
CONFIG_UART0_SERIAL_CONSOLE=y
CONFIG_UART0_TXBUFSIZE=256
CONFIG_USEC_PER_TICK=10000
# CONFIG_ARCH_LEDS is not set
CONFIG_USERLED=y
CONFIG_USERLED_LOWER=y
CONFIG_ARCH_BUTTONS=y
CONFIG_ARCH_IRQBUTTONS=y
CONFIG_INPUT=y
CONFIG_INPUT_BUTTONS=y
CONFIG_INPUT_BUTTONS_LOWER=y
CONFIG_DEV_GPIO=y
CONFIG_EXAMPLES_LEDS=y
CONFIG_EXAMPLES_BUTTONS=y
CONFIG_EXAMPLES_GPIO=y
CONFIG_BK7258_I2C1=y
CONFIG_I2C=y
CONFIG_I2C_DRIVER=y
CONFIG_SYSTEM_I2CTOOL=y
CONFIG_I2C_BITBANG=y
CONFIG_BK7258_SPI1=y
CONFIG_SPI=y
CONFIG_LCD=y
CONFIG_LCD_FRAMEBUFFER=y
CONFIG_VIDEO_FB=y
CONFIG_EXAMPLES_FB=y
CONFIG_MM_REGIONS=2
CONFIG_DRIVERS_VIDEO=y
```
